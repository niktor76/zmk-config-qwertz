## config/west.yml
```yaml
manifest:
  defaults:
    revision: v0.3         # or use "main" if you want latest development
  remotes:
    - name: zmkfirmware
      url-base: https://github.com/zmkfirmware
    - name: joelspadin
      url-base: https://github.com/joelspadin

  projects:
    - name: zmk
      remote: zmkfirmware
      revision: v0.3       # pin to the released 0.3 line (matches your workflow @v0.3)
      import: app/west.yml
    - name: zmk-locales
      remote: joelspadin
      revision: main
      path: modules/zmk-locales

  self:
    path: config
```
